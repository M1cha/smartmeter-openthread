## boards/arm/heltec_lora_node_151/Kconfig.board
```kconfig
config BOARD_HELTEC_LORA_NODE_151
	bool "Heltec LoRa Node 151"
	depends on SOC_STM32L151XC
```

## boards/arm/heltec_lora_node_151/Kconfig.defconfig
```kconfig
if BOARD_HELTEC_LORA_NODE_151

config BOARD
	default "heltec_lora_node_151"

endif # BOARD_HELTEC_LORA_NODE_151
```

## boards/arm/nrf52840_powermeter/Kconfig.board
```kconfig
# SPDX-License-Identifier: Apache-2.0

config BOARD_NRF52840_POWERMETER
	bool "nRF52840 power meter"
	depends on SOC_NRF52840_QIAA
```

## boards/arm/nrf52840_powermeter/Kconfig.defconfig
```kconfig
# SPDX-License-Identifier: Apache-2.0

if BOARD_NRF52840_POWERMETER

config BOARD
	default "nrf52840_powermeter"

config BT_CTLR
	default BT

endif # BOARD_NRF52840_POWERMETER
```

## boards/arm/nrf52840_powermeter/nrf52840_powermeter_defconfig
```kconfig
# SPDX-License-Identifier: Apache-2.0

CONFIG_SOC_SERIES_NRF52X=y
CONFIG_SOC_NRF52840_QIAA=y
CONFIG_BOARD_NRF52840_POWERMETER=y
CONFIG_CLOCK_CONTROL_NRF_K32SRC_RC=y

# Enable MPU
CONFIG_ARM_MPU=y

# Enable hardware stack protection
CONFIG_HW_STACK_PROTECTION=y

# enable uart driver
CONFIG_SERIAL=y

CONFIG_PINCTRL=y
```

## boards/m1cha/powermeter/Kconfig.defconfig
```kconfig
# SPDX-License-Identifier: Apache-2.0

if BOARD_M1CHA_POWERMETER

config BT_CTLR
	default BT

endif # BOARD_M1CHA_POWERMETER
```

## boards/m1cha/powermeter/Kconfig.m1cha_powermeter
```kconfig
# SPDX-License-Identifier: Apache-2.0

config BOARD_M1CHA_POWERMETER
	select SOC_NRF52840_QIAA
```

## boards/m1cha/powermeter/board.yml
```yaml
board:
  name: m1cha_powermeter
  full_name: Power Meter
  vendor: m1cha
  socs:
  - name: nrf52840
```

## boards/m1cha/powermeter/m1cha_powermeter_defconfig
```kconfig
# SPDX-License-Identifier: Apache-2.0

# Enable MPU
CONFIG_ARM_MPU=y

# Enable hardware stack protection
CONFIG_HW_STACK_PROTECTION=y

# enable GPIO
CONFIG_GPIO=y

# Use internal oscillator
CONFIG_CLOCK_CONTROL_NRF_K32SRC_RC=y
```

## dts/bindings/temprng/temprng.yaml
```yaml
description: STM32 family RNG based on internal temperature sensor

compatible: "st,temp-rng"

include: base.yaml

properties:
    label:
      required: true

    io-channels:
      required: true
      description: ADC channel for temperature sensor
```

## modules/mqttsndev/Kconfig
```kconfig
config SMARTMETER_MQTTSN_DEVICE
	bool "Enable MQTTSN device library"

if SMARTMETER_MQTTSN_DEVICE

config SMARTMETER_MQTTSN_DEVICE_MAX_CLIENTID_LENGTH
	int "Max client ID length"
	default 23

config SMARTMETER_MQTTSN_DEVICE_BUFFER_SIZE
	int "Size of the TX and RX buffers"
	default 255

config SMARTMETER_MQTTSN_DEVICE_RECONNECT_WAIT_DURATION
	int "Number of seconds to wait before attempting a reconnect"
	default 30

config SMARTMETER_MQTTSN_DEVICE_STACK_SIZE
	int "System workqueue stack size"
	default 2048

config SMARTMETER_MQTTSN_DEVICE_THREAD_PRIORITY
	int "System workqueue priority"
	default -2 if COOP_ENABLED && !PREEMPT_ENABLED
	default  0 if !COOP_ENABLED
	default -1

config SMARTMETER_MQTTSN_DEVICE_WDT_MAX_WINDOW_MS
	int "Watchdog max window"
	default 120000
	depends on WATCHDOG

config SMARTMETER_MQTTSN_DEVICE_WDT_FEED_INTERVAL_MS
	int "Watchdog feed interval"
	default 10000
	depends on WATCHDOG

module = SMARTMETER_MQTTSN_DEVICE
module-str = smartmeter mqttsn device
source "subsys/logging/Kconfig.template.log_config"

endif # SMARTMETER_MQTTSN_DEVICE
```

## modules/rust/Kconfig
```kconfig
config SMARTMETER_RUST
	bool "smartmeter rust code"

config SMARTMETER_RUST_LOGGER
	bool "enable smartmeter logger"

config SMARTMETER_DEBUG_PROFILE
	bool "build with debug information"
```

## modules/temprng/Kconfig
```kconfig
config SMARTMETER_TEMPRNG
	bool "temperature sensor RNG"
	depends on SOC_FAMILY_STM32
	select ENTROPY_HAS_DRIVER
```
