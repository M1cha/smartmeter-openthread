## CMakeLists.txt
```
# SPDX-License-Identifier: Apache-2.0

cmake_minimum_required(VERSION 3.20.0)

find_package(Zephyr REQUIRED HINTS $ENV{ZEPHYR_BASE})
project(router)

target_sources(app PRIVATE
	src/main.c
)
```

## Kconfig
```
source "Kconfig.zephyr"

module = APP
module-str = APP
source "subsys/logging/Kconfig.template.log_config"
```

## prj.conf
```kconfig
# Logging
CONFIG_NET_LOG=y
CONFIG_LOG=y
CONFIG_PRINTK=y

CONFIG_OPENTHREAD_MTD=n
CONFIG_OPENTHREAD_FTD=y
CONFIG_OPENTHREAD_DEFAULT_TX_POWER=8
CONFIG_MQTT_SN_LIB=n
CONFIG_SMARTMETER_MQTTSN_DEVICE=n
```

## src/main.c
```c
/*
 * SPDX-License-Identifier: Apache-2.0
 */

#include <zephyr/kernel.h>

#include <zephyr/logging/log.h>
LOG_MODULE_REGISTER(router, CONFIG_APP_LOG_LEVEL);

int main(void)
{
	LOG_DBG("Init");
	return 0;
}
```
